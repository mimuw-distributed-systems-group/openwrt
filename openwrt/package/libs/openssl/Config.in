## openwrt/package/libs/openssl/Config.in
```kconfig
menu "Configuration"
	depends on PACKAGE_libopenssl

config OPENSSL_WITH_EC
	bool
	default y
	prompt "Enable elliptic curve support"

config OPENSSL_WITH_EC2M
        bool
        depends on OPENSSL_WITH_EC
        prompt "Enable ec2m support"

config OPENSSL_WITH_DEPRECATED
	bool
	default y
	prompt "Include deprecated APIs"
	help
	  This drops all deprecated API, including engine support.

endmenu
```
